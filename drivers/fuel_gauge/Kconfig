## drivers/fuel_gauge/sample_bms/Kconfig
```kconfig
config SAMPLE_BMS
    bool "Sample BMS"
    depends on DT_HAS_SAMPLE_BMS_ENABLED
    select I2C
    help
      Sample BMS driver for battery gauge.
```

## dts/bindings/fuel_gauge/sample-bms.yaml
```yaml
# Copyright (c) 2024, Off-Grid Europe GmbH
#
# SPDX-License-Identifier: Apache-2.0

description: |
  Sample BMS device tree binding for the fuel gauge.


compatible: "sample-bms"

include: [i2c-device.yaml, fuel-gauge.yaml]
```
